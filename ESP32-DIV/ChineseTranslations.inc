  {"More", "更多"},
  {"Settings", "设置"},
  {"Tools", "工具"},
  {"About", "关于"},
  {"WiFi", "无线网络"},
  {"Bluetooth", "蓝牙"},
  {"2.4GHz", "2.4GHz"},
  {"SubGHz", "SubGHz"},
  {"RFID/NFC", "RFID/NFC"},
  {"GPS", "GPS"},
  {"Back", "返回"},
  {"Save", "保存"},
  {"Saved", "已保存"},
  {"No changes", "无更改"},
  {"Save FAILED", "保存失败"},
  {"Exit", "退出"},
  {"Start", "开始"},
  {"Stop", "停止"},
  {"Enabled", "已启用"},
  {"Disabled", "已禁用"},
  {"Toggle", "切换"},
  {"Main Menu", "主菜单"},
  {"Back to Main Menu", "返回主菜单"},
  {"Next Page", "下一页"},
  {"Prev Page", "上一页"},
  {"Packet Monitor", "数据包监视器"},
  {"Beacon Spammer", "信标垃圾邮件发送者"},
  {"WiFi Deauther", "无线网络断开"},
  {"Probe Request Flood", "探测请求洪水"},
  {"Deauth Detector", "断开检测器"},
  {"WiFi Scanner", "WiFi 扫描器"},
  {"Captive Portal", "入网门户"},
  {"Hidden SSID Revealer", "隐藏SSID显示器"},
  {"WPS Scanner", "WPS扫描仪"},
  {"ARP Scanner", "ARP扫描仪"},
  {"Karma Attack", "业力攻击"},
  {"BLE Jammer", "BLE干扰器"},
  {"BLE Spoofer", "BLE欺骗器"},
  {"Sour Apple", "酸苹果"},
  {"BLE Spam All", "BLE垃圾邮件"},
  {"Apple Juice", "苹果汁"},
  {"AirTag Spoofer", "AirTag欺骗器"},
  {"AirTag Sniffer", "AirTag嗅探器"},
  {"FindMy Attacks", "FindMy Attacks"},
  {"Sniffer", "嗅探器"},
  {"BLE Scanner", "BLE 扫描器"},
  {"BLE Rubber Ducky", "BLE Rubber Ducky"},
  {"Skimmer Detect", "Skimmer Detect"},
  {"Scanner", "扫描器"},
  {"Proto Kill", "Proto Kill"},
  {"ESB Sniffer", "ESB 嗅探器"},
  {"ESB Replay", "ESB重播"},
  {"MouseJack Scan", "MouseJack Scan"},
  {"MouseJack Inject", "MouseJack Inject"},
  {"Replay Attack", "重放攻击"},
  {"De Bruijn / Brute", "De Bruijn/Brute"},
  {"SubGHz Jammer", "SubGHz 干扰器"},
  {"Jamming Detector", "干扰检测器"},
  {"Saved Profile", "已保存配置"},
  {"Saved Profiles", "已保存配置"},
  {"Serial Monitor", "串行监视器"},
  {"Touch Calibrate", "触摸校准"},
  {"SD File Manager", "SD 文件管理器"},
  {"NRF Tuning", "NRF调谐"},
  {"IR Remote", "红外遥控"},
  {"Games", "游戏"},
  {"Snake", "蛇形"},
  {"Pong", "Pong"},
  {"Tetris", "Tetris"},
  {"Breakout", "Breakout"},
  {"Space Invaders", "Space Invaders"},
  {"Missile Command", "导弹指挥"},
  {"Connect Four", "连接四个"},
  {"Blackjack", "二十一点"},
  {"Five Card Draw", "五张牌抽取"},
  {"8 Ball Pool", "8个球池"},
  {"Score:", "得分："},
  {"GAME OVER", "游戏结束"},
  {"Card Reader", "读卡器"},
  {"Card Clone", "卡片克隆"},
  {"Erase", "擦除"},
  {"Dump", "转储"},
  {"Decode Access", "解码访问权限"},
  {"Jam Reader", "果酱读卡器"},
  {"Tag Disrupt", "标签中断"},
  {"Disrupt Emulate", "中断仿真"},
  {"Wardriver", "Wardriver"},
  {"Satellite Scanner", "卫星扫描仪"},
  {"Record", "录制"},
  {"Universal Controller", "通用控制器"},
  {"Brightness", "亮度"},
  {"Theme", "主题"},
  {"Accent", "口音"},
  {"Auto Scan", "自动扫描"},
  {"Language", "语言"},
  {"English", "英语"},
  {"Spanish", "西班牙语"},
  {"NFC Reader", "NFC阅读器"},
  {"NFC shared hardware", "NFC共享硬件"},
  {"Leaving NFC safely requires reading a tag. SELECT: Continue. LEFT: Cancel.", "安全离开NFC需要阅读标签。选择：继续。左：取消。"},
  {"Continue", "继续"},
  {"Present a tag to the antenna. To leave, scan a tag or power off the device.", "向天线出示标签。要离开，请扫描标签或关闭设备电源。"},
  {"Tag required", "需要标签"},
  {"Present a tag to exit", "出示标签以退出"},
  {"NFC protected exit", "NFC保护的退出"},
  {"Read tag", "读取标签"},
  {"Exit blocked", "已阻止退出"},
  {"Read tag or power off", "读取标签或关闭电源"},
  {"Reader unavailable — power off", "读取器不可用—关闭电源"},
  {"Cancel cannot close this NFC session safely.", "取消无法安全关闭此NFC会话。"},
  {"Present an ISO14443A tag to exit.", "出示ISO14443A标签以退出。"},
  {"To exit, scan a tag. Otherwise power off the device.", "要退出，请扫描标签。否则，请关闭设备电源。"},
  {"Present a tag to continue. Power off the device to leave.", "请出示标签以继续。关闭设备电源以离开。"},
  {"Reader unavailable", "阅读器不可用"},
  {"Present a tag to continue", "显示标签以继续"},
  {"Waiting for the NFC reader...", "等待NFC阅读器..."},
  {"Waiting for an ISO14443A tag...", "等待ISO14443A标签..."},
  {"Present ISO14443A tag", "显示ISO14443A标签"},
  {"Tag detected", "检测到标签"},
  {"Scan", "扫描"},
  {"Dark", "暗"},
  {"Light", "亮"},
  {"[Dark]", "[暗]"},
  {"[Light]", "[亮]"},
  {"Orange", "橙色"},
  {"Green", "绿色"},
  {"MK Green", "MK绿色"},
  {"Red", "红色"},
  {"Cyan", "青色"},
  {"Purple", "紫色"},
  {"Yellow", "黄色"},
  {"White", "白色"},
  {"Board", "棋盘"},
  {"Build", "构建"},
  {"Credits", "旅行基金"},
  {"SELECT / tap to go back", "选择/轻触返回"},
  {"GNSS Satellites", "GNSS卫星"},
  {"Split", "拆分"},
  {"Sky", "天空"},
  {"Signals", "信号"},
  {"Strongest signals", "最强信号"},
  {"Waiting for position / GGA", "等待位置/GGA"},
  {"Center=overhead  Edge=horizon", "中心=开销边缘=地平线"},
  {"Display buffer failed", "显示缓冲区失败"},
  {"Freq:", "频率："},
  {"Bit:", "位："},
  {"Data:", "数据："},
  {"Mode:", "模式："},
  {"Status:", "状态："},
  {"Sending...", "正在发送..."},
  {"Done!", "完成！"},
  {"TX blocked", "TX被阻止"},
  {"No valid capture yet", "还没有有效的捕获"},
  {"Profile saved to EEPROM!", "配置文件已保存到EEPROM ！"},
  {"Save failed: storage full", "保存失败：存储空间已满"},
  {"Delete a Saved Profile", "删除保存的个人资料"},
  {"[!] Press [UP] to start", "[!]按[向上]开始"},
  {"[!] Preparing", "[!]准备"},
  {"[*] Configuring channel to (", "[*]将频道配置为("},
  {"[!] SSID list ready", "[!] SSID列表就绪"},
  {"[!] Cycling all SSIDs", "[!]循环所有SSID"},
  {"[*] Starting broadcast", "[*]开始广播"},
  {"[!!] Random flood mode", "[!!]随机洪水模式"},
  {"[!!] Press [Select] to exit", "[!!]按[选择]退出"},
  {"NRF Radios", "NRF收音机"},
  {"2: always use NRF1 + NRF2", "2 ：始终使用NRF1 + NRF2"},
  {"ALL: use every available NRF", "全部：使用所有可用的NRF"},
  {"Saving...", "保存..."},
  {"Saved to SD", "保存到SD"},
  {"Import", "导入"},
  {"Rescan", "重新扫描"},
  {"Prev", "上一个"},
  {"Next", "下一步"},
  {"Reset", "重置"},
  {"Flood", "洪水"},
  {"Shuffle", "洗牌"},
  {"NFC DEVICE LOCK", "NFC设备锁定"},
  {"Scan enrolled NFC card", "扫描已注册的NFC卡"},
  {"NFC READER ERROR", "NFC读卡器错误"},
  {"Retrying - no bypass", "重试-无旁路"},
  {"ACCESS DENIED", "访问被拒绝"},
  {"Unknown NFC card", "未知的NFC卡"},
  {"DEVICE UNLOCKED", "设备已解锁"},
  {"Access granted", "已授予访问权限"},
  {"Enable", "启用"},
  {"Disable", "禁用"},
  {"Lock is enabled", "锁定已启用"},
  {"Lock is disabled", "锁定已禁用"},
  {"Scan a card to enable", "扫描卡以启用"},
  {"NFC UNLOCK DISABLED", "NFC解锁已禁用"},
  {"NFC UNLOCK CONFIGURED", "NFC解锁已配置"},
  {"NVS ERROR", "NVS错误"},
  {"Stored UID erased", "已清除存储的UID"},
  {"UID could not be erased", "无法清除UID"},
  {"UID could not be stored", "无法存储UID"},
  {"PN532 unavailable", "PN532不可用"},
  {"Card stored - lock active on reboot", "存储卡-重启时锁定有效"},
  {"Russian", "俄语"},
  {"Portuguese", "葡萄牙语"},
  {"Japanese", "日语"},
  {"Thai", "泰语"},
  {"Korean", "韩语"},
  {"Chinese", "简体中文"},
  {"Ch:", "频道:"},
  {"IR Record", "记录红外"},
  {"Live IR Scope", "实时红外信号"},
  {"Signal Status", "信号状态"},
  {"State: Captured", "状态: 已捕获"},
  {"State: Sending", "状态: 发送中"},
  {"State: Listening", "状态: 接收中"},
  {"State: Capture too long", "状态: 信号过长"},
  {"[!] IR capture overflow", "[!] 红外信号过长"},
  {"Type:", "类型:"},
  {"Bits:", "位数:"},
  {"Raw:", "原始:"},
  {"kHz:", "kHz:"},
  {"Name:", "名称:"},
  {"Val:", "值:"},
  {"Activity", "活动"},
  {"Ready", "就绪"},
  {"Pause", "暂停"},
  {"Clear", "清除"},
  {"Select", "选择"},
  {"Send", "发送"},
  {"Capture", "捕获"},
  {"Reload", "重新加载"},
  {"Browse", "浏览"},
  {"Channel:", "频道:"},
  {"Scanning...", "正在扫描..."},
  {"No devices found.", "未找到设备。"},
  {"Frame buffer error", "显示缓冲区错误"},
  {"SD not available", "SD不可用"},
  {"SD not mounted", "SD未挂载"},
  {"SD card not detected", "未检测到SD卡"},
  {"SD busy. Try again.", "SD忙，请重试。"},
  {"Open file failed", "打开文件失败"},
  {"Write failed", "写入失败"},
  {"Read failed", "读取失败"},
  {"Delete", "删除"},
  {"Details", "详情"},
  {"Devices", "设备"},
  {"Networks", "网络"},
  {"Auto", "自动"},
  {"Listen", "监听"},
  {"Log", "日志"},
  {"Setup", "设置"},
  {"View", "查看"},
  {"Play", "播放"},
  {"Run", "运行"},
  {"OK", "确定"},
  {"Active", "活动"},
  {"Add", "添加"},
  {"Already stored on SD", "已保存到SD"},
  {"BLE: low memory", "BLE: 内存不足"},
  {"Cannot create /ir", "无法创建/ir"},
  {"Capture a signal first", "请先捕获信号"},
  {"Capture/import it again", "请重新捕获或导入"},
  {"Connecting Wi-Fi", "正在连接Wi-Fi"},
  {"Delete FAILED", "删除失败"},
  {"Delete selected item?", "删除所选项目？"},
  {"Delete this script?", "删除此脚本？"},
  {"Description:", "说明:"},
  {"Empty folder", "空文件夹"},
  {"Exit and try again", "退出并重试"},
  {"Finding hidden SSIDs.", "正在查找隐藏SSID。"},
  {"Force", "强制"},
  {"Initializing SD...", "正在初始化SD..."},
  {"Initializing [do not exit]", "正在初始化[请勿退出]"},
  {"Initializing...", "正在初始化..."},
  {"Insert SD card with", "请插入包含以下内容的SD卡"},
  {"Invalid calibration", "校准无效"},
  {"Invalid capture", "捕获无效"},
  {"Keeping factory profile", "保留出厂配置"},
  {"Key not available in this profile", "此配置中没有该按键"},
  {"Looking for WPS APs.", "正在查找WPS接入点。"},
  {"No Manufacturer Data", "无制造商数据"},
  {"No Service Data", "无服务数据"},
  {"No Service UUID", "无服务UUID"},
  {"No WPS networks found.", "未找到WPS网络。"},
  {"No capture to save yet.", "暂无可保存的捕获。"},
  {"No compatible tracker found", "未找到兼容的追踪器"},
  {"No credentials", "无凭据"},
  {"No fix yet", "尚未定位"},
  {"No hidden SSIDs found.", "未找到隐藏SSID。"},
  {"No hosts found.", "未找到主机。"},
  {"No networks found.", "未找到网络。"},
  {"No saved profiles.", "没有已保存的配置。"},
  {"No script selected", "未选择脚本"},
  {"No selection", "未选择"},
  {"Not paired/connected", "未配对或连接"},
  {"Nothing captured", "尚未捕获"},
  {"Open", "打开"},
  {"Press Delete again to confirm", "再次按删除以确认"},
  {"Press Rescan.", "请按重新扫描。"},
  {"Protocol not enabled in build", "此版本未启用该协议"},
  {"Rebooting...", "正在重启..."},
  {"Returning...", "正在返回..."},
  {"SD card OK", "SD卡正常"},
  {"SD mount failed", "SD挂载失败"},
  {"SD remove failed", "SD删除失败"},
  {"Scan Status", "扫描状态"},
  {"Scripts Found:", "找到脚本:"},
  {"Starting SD Update...", "正在开始SD更新..."},
  {"Starting Web OTA...", "正在开始Web OTA..."},
  {"Startup failed", "启动失败"},
  {"Touch Start to update", "点击开始进行更新"},
  {"Touch and hold for more options", "长按查看更多选项"},
  {"Touch and release target", "点击目标后松开"},
  {"Touch to retry", "点击重试"},
  {"Touch to retry or Back", "点击重试或返回"},
  {"Too many files in /ir", "/ir中的文件过多"},
  {"Update OK!", "更新成功！"},
  {"Updating...", "正在更新..."},
  {"Use 'Refresh' to scan for scripts", "使用“刷新”扫描脚本"},
  {"Use icons above for quick actions", "使用上方图标快速操作"},
  {"Wait a moment.", "请稍候。"},
  {"Wait for SAVE / R-SAVE", "等待SAVE / R-SAVE"},
  {"Web OTA Started...", "Web OTA已启动..."},
  {"Web server ready!", "Web服务器已就绪！"},
  {"Wi-Fi OK", "Wi-Fi正常"},
  {"2.4 GHz Spectrum", "2.4GHz频谱"},
  {"2.4GHz Scanner", "2.4GHz扫描器"},
  {"802.11 monitor - standby", "802.11监视器-待机"},
  {"A match is a warning only,", "匹配仅表示警告，"},
  {"Access via browser", "通过浏览器访问"},
  {"Add SD profiles:", "添加SD配置:"},
  {"Back  Check = save to SD", "返回  选择=保存到SD"},
  {"Clone Access Point", "克隆接入点"},
  {"Credentials List:", "凭据列表:"},
  {"Direction: retry  Center: exit", "方向键:重试  中键:退出"},
  {"Double-tap to execute", "双击执行"},
  {"Executing…", "正在执行…"},
  {"Export", "导出"},
  {"Go start/stop", "开始/停止"},
  {"Info", "信息"},
  {"Inject", "注入"},
  {"IR hardware unavailable", "红外硬件不可用"},
  {"PN532 not found. Check SPI wiring/pins.", "未找到PN532，请检查SPI。"},
  {"VS1838B receiver was not detected on GPIO21.", "GPIO21未检测到VS1838B。"},
  {"Please Wait", "请稍候"},
  {"Profile", "配置"},
  {"Replay", "重放"},
  {"Packets", "数据包"},
  {"RF Status", "RF状态"},
  {"Raw read failed", "原始数据读取失败"},
  {"SD Status:", "SD状态:"},
  {"SD Update", "SD更新"},
  {"Scanning WiFi", "正在扫描WiFi"},
  {"Networks:", "网络:"},
  {"Page", "页"},
  {"Starting deauth monitor", "启动断开监视"},
  {"Scanning WiFi networks", "正在扫描WiFi网络"},
  {"Current SSID:", "当前SSID:"},
  {"Status: Active", "状态: 已启用"},
  {"Status: Inactive", "状态: 未启用"},
  {"Access Point started", "接入点已启动"},
  {"Access Point start failed", "接入点启动失败"},
  {"Access Point stopped", "接入点已停止"},
  {"DNS server started", "DNS服务已启动"},
  {"DNS server stopped", "DNS服务已停止"},
  {"Web server started", "Web服务已启动"},
  {"Web server stopped", "Web服务已停止"},
  {"Attack already active", "功能已经启用"},
  {"Attack already inactive", "功能已经停止"},
  {"Looking for nearby APs", "正在搜索附近接入点"},
  {"Press Scan to retry or Back to cancel", "扫描重试，返回取消"},
  {"Pick", "选择"},
  {"Clone", "克隆"},
  {"Creds", "凭据"},
  {"Scanning.", "正在扫描。"},
  {"Select Category", "选择类别"},
  {"Tag Details", "标签详情"},
  {"Tap row or Pick to clone", "点击行或选择以克隆"},
  {"Target: All hidden APs", "目标: 所有隐藏AP"},
  {"WiGLE config", "WiGLE设置"},
  {"not proof of a skimmer.", "不能证明存在盗刷器。"},
  {"Sound", "声音"},
  {"@nav.scan", "扫描"},
  {"@nav.rescan", "重扫"},
  {"@nav.prev", "上一"},
  {"@nav.next", "下一"},
  {"@nav.view", "查看"},
  {"@nav.back", "返回"},
  {"@nav.exit", "退出"},
  {"@nav.open", "打开"},
  {"@nav.refresh", "刷新"},
  {"User", "用户"},
  {"Pass", "密码"},
  {"SSID", "SSID"},
  {"PIN Device Lock", "PIN设备锁"},
  {"PIN DEVICE LOCK", "PIN设备锁"},
  {"Enter PIN", "输入PIN"},
  {"Incorrect PIN", "PIN错误"},
  {"PIN must contain 4-8 digits", "PIN须为4至8位数字"},
  {"SET NEW PIN", "设置新PIN"},
  {"CONFIRM PIN", "确认PIN"},
  {"Enter PIN again", "再次输入PIN"},
  {"PIN MISMATCH", "PIN不匹配"},
  {"PINs do not match - try again", "PIN不匹配，请重试"},
  {"PIN UNLOCK DISABLED", "PIN解锁已禁用"},
  {"Stored PIN erased", "已删除保存的PIN"},
  {"PIN could not be erased", "无法删除PIN"},
  {"PIN UNLOCK CONFIGURED", "PIN解锁已配置"},
  {"PIN lock active on reboot", "重启后启用PIN锁"},
  {"PIN could not be stored", "无法保存PIN"},
